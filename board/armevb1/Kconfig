## board/armevb1/Kconfig
```kconfig
if TARGET_ARMEVB1

config SYS_BOARD
    string
    default "armevb1"

config SYS_SOC
    string
    default "lh77790"

config SYS_CONFIG_NAME
    string
    default "armevb1"

config GENERIC_FLASH_DRIVER
    def_bool y

endif
```

## board/evb4510/Kconfig
```kconfig
if TARGET_EVB4510

config SYS_BOARD
    string
    default "evb4510"

config SYS_SOC
    string
    default "s3c4510b"

config SYS_CONFIG_NAME
    string
    default "evb4510"

choice
    prompt "Select the S3C4510 platform flavor"
    default PLATFORM_EVALUATOR7T

config PLATFORM_EVALUATOR7T
    prompt "Support the ARM Evaluator-7T board"
    bool

config PLATFORM_NETSTART
    prompt "Support the NET-Start! board"
    bool
    select SYS_I2C_S3C4510
    select RTC_DS1672
    select CMD_DATE
    select CMD_I2C
endchoice

config MONITOR_IS_IN_RAM
    bool "U-Boot is loaded in to RAM by a pre-loader"

config SYS_MALLOC_LEN
    hex
    default 0x18000 if PLATFORM_EVALUATOR7T
    default 0x20000 if PLATFORM_NETSTART

config GENERIC_FLASH_DRIVER
    def_bool y

endif
```

## configs/armevb1_defconfig
```kconfig
CONFIG_ARM=y
CONFIG_TARGET_ARMEVB1=y

CONFIG_TEXT_BASE=0
CONFIG_SYS_CLK_FREQ=25000000

CONFIG_SYS_MALLOC_LEN=0x6000
CONFIG_SYS_LOAD_ADDR=0x100
# CONFIG_SYS_ARM_MMU is not set
# CONFIG_SYS_ARM_CACHE_CP15 is not set
# CONFIG_DISPLAY_CPUINFO is not set

CONFIG_ENV_IS_IN_FLASH=y
CONFIG_ENV_ADDR=0x04020000
CONFIG_ENV_SECT_SIZE=0x10000
CONFIG_ENV_SIZE=0x1000
CONFIG_SYS_MAX_FLASH_SECT=8

CONFIG_DEBUG_UART=y

CONFIG_MTD_NOR_FLASH=y
# CONFIG_BLOCK_CACHE is not set
# CONFIG_NET is not set
# CONFIG_MMC is not set

# CONFIG_CMD_ELF is not set
```

## configs/evb4510_defconfig
```kconfig
CONFIG_ARM=y
CONFIG_TARGET_EVB4510=y
# CONFIG_PLATFORM_EVALUATOR7T is not set
CONFIG_PLATFORM_NETSTART=y
# CONFIG_MONITOR_IS_IN_RAM is not set

CONFIG_TEXT_BASE=0
CONFIG_SYS_CLK_FREQ=50000000
CONFIG_SYS_LOAD_ADDR=0x100
# CONFIG_SYS_ARM_MMU is not set
# CONFIG_SYS_ARM_CACHE_CP15 is not set
# CONFIG_DISPLAY_CPUINFO is not set

CONFIG_ENV_SIZE=0x1000
CONFIG_ENV_IS_IN_FLASH=y
CONFIG_ENV_ADDR=0x05020000
CONFIG_SYS_MAX_FLASH_SECT=35
CONFIG_ENV_SECT_SIZE=0x10000

CONFIG_SPECIFY_CONSOLE_INDEX=y
CONFIG_CONS_INDEX=1
CONFIG_DEBUG_UART=y

CONFIG_MTD_NOR_FLASH=y
# CONFIG_BLOCK_CACHE is not set
# CONFIG_NET is not set
# CONFIG_MMC is not set

CONFIG_FS_CRAMFS=y

CONFIG_CMD_CRAMFS=y
# CONFIG_CMD_ELF is not set
CONFIG_CMD_MEMTEST=y
```
